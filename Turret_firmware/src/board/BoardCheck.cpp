#include "BoardCheck.h"

#include "board/Expander.h"
#include "board/I2cBus.h"
#include "board/Log.h"
#include "pins.h"
#include "version_gen.h" // generated by scripts/git_version.py
#include <esp_ota_ops.h>

namespace {
const ulong REPEAT_MS = 5000;

bool busOk = false;
bool expanderSeen = false;
bool railsOff = false;
bool rightBoard = false;

const char *SeenBoardName() {
  return expanderSeen ? "v2 (expander at 0x20)" : "v0.1 (nothing at 0x20)";
}

// The other OTA slot, if it holds an app image.
const esp_partition_t *OtherApp() {
  const esp_partition_t *other = esp_ota_get_next_update_partition(nullptr);
  esp_app_desc_t description;
  if (other == nullptr || esp_ota_get_partition_description(other, &description) != ESP_OK) {
    return nullptr;
  }
  return other;
}

void PrintWrongBoard() {
  Log.println();
  Log.printf("WRONG BOARD: this firmware (%s) is built for %s, the board looks like a %s.\n", FIRMWARE_VERSION,
             BOARD_NAME, SeenBoardName());
  if (!busOk) {
    Log.println("  (I2C bus did not start: stuck bus?)");
  }
  Log.printf("  Nothing is driven%s. Flash the build for this board over USB:\n",
             railsOff ? "; v2 rails switched off" : "");
  Log.println(expanderSeen ? "    pio run -e turret2_v2 -t upload" : "    pio run -e turret2 -t upload");
  const esp_partition_t *other = OtherApp();
  if (other != nullptr) {
    Log.printf("  or type \"rollback\" to boot the other OTA slot (%s), the firmware that was there before.\n",
               other->label);
  }
  Log.println("  \"scan\" lists the I2C devices.");
}

void Rollback() {
  const esp_partition_t *other = OtherApp();
  if (other == nullptr) {
    Log.println("rollback: the other OTA slot holds no app");
    return;
  }
  // esp_ota_set_boot_partition() verifies the image before selecting it.
  esp_err_t err = esp_ota_set_boot_partition(other);
  if (err != ESP_OK) {
    Log.printf("rollback: %s refused (%s)\n", other->label, esp_err_to_name(err));
    return;
  }
  Log.printf("rollback: booting %s\n", other->label);
  Serial.flush();
  delay(100);
  // No I2S clock and no PWM were ever started: nothing to stop before the restart.
  ESP.restart();
}
} // namespace

namespace BoardCheck {

void Run() {
  busOk = I2cBus::Start();
  expanderSeen = busOk && Expander::Probe();
  if (expanderSeen) {
    // First of all, whatever the build: rails off (outputs kept across a software restart).
    railsOff = Expander::AllOff();
  }
  rightBoard = expanderSeen == (BOARD_HAS_EXPANDER != 0);
}

bool IsRightBoard() {
  return rightBoard;
}
bool HasExpander() {
  return expanderSeen;
}
bool RailsOff() {
  return railsOff;
}

void PrintReport() {
#if BOARD_HAS_EXPANDER
  Log.printf("Board check: %s, TCAL6416 at 0x%02X, rails %s\n", BOARD_NAME, EXPANDER_ADDRESS,
             railsOff ? "all off" : "NOT CONFIRMED OFF (read back failed)");
#else
  Log.printf("Board check: %s, nothing at 0x%02X\n", BOARD_NAME, EXPANDER_ADDRESS);
#endif
}

void HaltWrongBoard() {
  CrashLog::Begin(esp_reset_reason());
  Serial.begin(115200);
  ulong lastPrint = 0;
  bool first = true;
  String line;
  for (;;) {
    ulong now = millis();
    if (first || now - lastPrint >= REPEAT_MS) {
      first = false;
      lastPrint = now;
      PrintWrongBoard();
    }
    while (Serial.available() > 0) {
      char c = (char)Serial.read();
      if (c != '\n' && c != '\r') {
        if (line.length() < 32) {
          line += c;
        }
        continue;
      }
      line.trim();
      if (line == "rollback") {
        Rollback();
      } else if (line == "scan") {
        I2cBus::Scan();
      } else if (line.length() > 0) {
        Log.println("wrong board: only \"rollback\" and \"scan\" are available");
      }
      line = "";
    }
    delay(20);
  }
}

} // namespace BoardCheck
